# file: Screen2.ioc
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Mcu.Family=STM32F1
Mcu.Name=STM32F103C(8-B)Tx
Mcu.Package=LQFP48
NVIC.PriorityGroup=NVIC_PRIORITYGROUP_4
PA13.Mode=Serial_Wire
PA13.Signal=SYS_JTMS-SWDIO
PA14.Mode=Serial_Wire
PA14.Signal=SYS_JTCK-SWCLK
PD0-OSC_IN.Mode=HSE-External-Oscillator
PD0-OSC_IN.Signal=RCC_OSC_IN
PD1-OSC_OUT.Mode=HSE-External-Oscillator
PD1-OSC_OUT.Signal=RCC_OSC_OUT
ProjectManager.HeapSize=0x200
ProjectManager.StackSize=0x400
ProjectManager.TargetToolchain=STM32CubeIDE
RCC.APB1Freq_Value=8000000
RCC.APB2Freq_Value=8000000
RCC.SYSCLKSource=RCC_SYSCLKSOURCE_HSE
board=custom

// file: Core/Src/main.c
/* USER CODE BEGIN Header */
/**
  ******************************************************************************
  * @file           : main.c
  * @brief          : Main program body
  ******************************************************************************
  * @attention
  *
  * Copyright (c) 2022 STMicroelectronics.
  * All rights reserved.
  *
  * This software is licensed under terms that can be found in the LICENSE file
  * in the root directory of this software component.
  * If no LICENSE file comes with this software, it is provided AS-IS.
  *
  ******************************************************************************
  */
/* USER CODE END Header */
#include "main.h"

/* USER CODE BEGIN Includes */
#include "lcd.h"
#include "keypad.h"
/* USER CODE END Includes */

void SystemClock_Config(void);
static void MX_GPIO_Init(void);

int main(void)
{

  /* MCU Configuration--------------------------------------------------------*/

  /* Reset of all peripherals, Initializes the Flash interface and the Systick. */
  HAL_Init();

  /* Configure the system clock */
  SystemClock_Config();

  /* Initialize all configured peripherals */
  MX_GPIO_Init();
  /* USER CODE BEGIN 2 */
  /*
  keypad_init();

  HAL_Delay(10); //Estabilizacion
  uint32_t num_entero=9;
  char str_num_entero[7]; //Guardar como string
  sprintf(str_num_entero, "val=%3d", num_entero); //Conversion de flotante a string
  float num_f=3.7,temporal_frac;
  uint8_t p_entera,p_frac;
  char str_entera[2];
  char str_frac[2];
  p_entera=(uint8_t)num_f; //Parte entera
  temporal_frac=(num_f-p_entera)*100; //.7*100=70
  p_frac=(uint8_t)temporal_frac;
  sprintf(str_entera, "%2d",p_entera);
  sprintf(str_frac, "%2d",p_frac); //Conversion de flotante a string

  lcd_init(); //Inicializa LCD
  lcd_command(DISPLAY_ON_D_OFF_C_ON_B);
  lcd_gotoxy(1,1);
  lcd_puts("Hello World!",12);
  lcd_gotoxy(1,2); //Segunda fila
  lcd_puts(str_num_entero,7);
  lcd_putc(' ');
  lcd_puts(str_entera,2);
  lcd_putc('.');
  lcd_puts(str_frac,2);
  lcd_putc(0xe0); //Beta
  HAL_Delay(5000);
  lcd_clear(); //Borra pantalla */

  keypad_init();
  HAL_Delay(10);
  lcd_init();

  float num_f = 547.801,temporal_frac;
  uint32_t p_entera,p_frac;
  char str_entera[3];
  char str_frac[3];
  p_entera=(uint32_t)num_f; //Parte entera
  temporal_frac=(num_f-p_entera)*1000;
  p_frac=(uint32_t)temporal_frac;
  sprintf(str_entera, "%3d",p_entera);
  sprintf(str_frac, "%3d",p_frac);

  char tecla;

  uint32_t cursor_blink = 1; // 1 = on | 0 = off
  uint32_t cursor = 1;
  lcd_command(CURSOR_ON);

  /* USER CODE END 2 */

  /* Infinite loop */
  /* USER CODE BEGIN WHILE */
  while (1)
  {
	  /*
	  if (tecla=='#')
	  lcd_gotoxy(1,2); //Brinca a segunda linea
	  tecla=keypad_read();
	  if ((tecla!=0) && (tecla!='#')&& (tecla!='*'))
	  lcd_putc(tecla);
	  if (tecla=='*')
	  lcd_command(CURSOR_MOVE_LEFT); */

	  tecla = keypad_read();

	  if (tecla != 0 && tecla != '#' && tecla != '*' && tecla != 'A' && tecla != 'B' && tecla != 'C'
			  && tecla != 'D' && cursor == 1) lcd_putc(tecla);

	  if (tecla == 'B' && cursor == 1) {
		  if (cursor_blink == 1) {
			  lcd_command(CURSOR_BLINK_OFF);
			  cursor_blink = 0;
		  } else {
			  lcd_command(CURSOR_BLINK_ON);
			  cursor_blink = 1;
		  }
	  }

	  if (tecla == 'D') {
		  if (cursor == 1) {
			  lcd_command(CURSOR_OFF);
			  cursor = 0;
		  } else {
			  lcd_command(CURSOR_ON);
			  cursor = 1;
		  }
	  }

	  if (tecla == '*') lcd_command(CURSOR_MOVE_LEFT);

	  if (tecla == '#') lcd_command(CURSOR_MOVE_RIGHT);

	  if (tecla == 'C') lcd_clear();

	  if (tecla == 'A') {
		  lcd_clear();
		  lcd_puts("Hello World :D",14);

		  lcd_gotoxy(1,2);
		  lcd_puts(str_entera,3);
		  lcd_putc('.');
		  lcd_puts(str_frac,3);

		  lcd_putc(' ');
		  lcd_putc(0xc0);
	  }

    /* USER CODE END WHILE */

  }
}

void SystemClock_Config(void)
{
  RCC_OscInitTypeDef RCC_OscInitStruct = {0};
  RCC_ClkInitTypeDef RCC_ClkInitStruct = {0};

  /** Initializes the RCC Oscillators according to the specified parameters
  * in the RCC_OscInitTypeDef structure.
  */
  RCC_OscInitStruct.OscillatorType = RCC_OSCILLATORTYPE_HSE;
  RCC_OscInitStruct.HSEState = RCC_HSE_ON;
  RCC_OscInitStruct.PLL.PLLState = RCC_PLL_NONE;
  if (HAL_RCC_OscConfig(&RCC_OscInitStruct) != HAL_OK)
  {
    Error_Handler();
  }

  /** Initializes the CPU, AHB and APB buses clocks
  */
  RCC_ClkInitStruct.ClockType = RCC_CLOCKTYPE_HCLK|RCC_CLOCKTYPE_SYSCLK
                              |RCC_CLOCKTYPE_PCLK1|RCC_CLOCKTYPE_PCLK2;
  RCC_ClkInitStruct.SYSCLKSource = RCC_SYSCLKSOURCE_HSE;
  RCC_ClkInitStruct.AHBCLKDivider = RCC_SYSCLK_DIV1;
  RCC_ClkInitStruct.APB1CLKDivider = RCC_HCLK_DIV1;
  RCC_ClkInitStruct.APB2CLKDivider = RCC_HCLK_DIV1;

  if (HAL_RCC_ClockConfig(&RCC_ClkInitStruct, FLASH_LATENCY_0) != HAL_OK)
  {
    Error_Handler();
  }
}

static void MX_GPIO_Init(void)
{

  /* GPIO Ports Clock Enable */
  __HAL_RCC_GPIOD_CLK_ENABLE();
  __HAL_RCC_GPIOA_CLK_ENABLE();

}

void Error_Handler(void)
{
  __disable_irq();
  while (1)
  {
  }
}
